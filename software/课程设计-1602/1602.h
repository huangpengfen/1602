/************************************************************************
*实验描述：基于STC89C52RC控制的1602液晶显示
	  		
*************************************************************************/
//#include<reg52.h>

/*************************************************************************
 * 函数名：main
 * 描述  ：主函数
 * 输入  ：无
 * 输出  ：无
 * 调用  ：内部调用
 *************************************************************************/

sbit rs=P2^5;		/*定义1602液晶数据/命令控制端*/			  
sbit rw=P2^6;		/*定义1602液晶读写控制端*/				  
sbit en=P2^7;		/*定义1602液晶使能端*/
unsigned char code table1[]="T:";	/*定义数组table1存放固定显示内容*/
unsigned char code table0[]="H:"; /*定义数组table0存放十进制数*/ 

/********************************************************************
 * 函数名：delay_10us
 * 描述  ：软件微秒级延时(12Mhz的晶振)
 * 输入  ：-num:	控制需要延时多少微秒。如num等于1，即延时10微秒
 * 输出  ：无
 * 调用  ：外部调用
 ********************************************************************/
void delay_10us(unsigned int num)
{
	while(num--)
		;
}

/********************************************************************
 * 函数名：delay_ms
 * 描述  ：软件毫秒级延时(12Mhz的晶振)
 * 输入  ：-num:	控制需要延时多少毫秒。如num等于1，即延时1毫秒
 * 输出  ：无
 * 调用  ：外部调用
 ********************************************************************/
void delay_ms(unsigned int num)
{
	unsigned int i;
	for(i=0;i<num;i++)
	{
		delay_10us(100);
	}
}

/********************************************************************
 * 函数名：delay_s
 * 描述  ：软件秒级延时(12Mhz的晶振)
 * 输入  ：-num:	控制需要延时多少秒。如num等于1，即延时1秒
 * 输出  ：无
 * 调用  ：外部调用
 ********************************************************************/
void delay_s(unsigned int num)
{
	unsigned int i;
	for(i=0;i<num;i++)
	{
		delay_ms(1000);
	}
}

/*****************************
* 函数名：write_command
* 描述：1602液晶写指令函数
* 输入：无
* 输出：无
* 调用：外部调用
******************************/
void write_command(unsigned char command)	  /*依照时序图编写*/
{
	unsigned char xx;
	rs=0;					                  /*数据/命令端选择为 “指令”（1为数据 0为指令*/
	rw=0;					  				  /*选择向1602液晶写数据*/
	xx=command;				 				  /*传入数据至P0口*/
	P0=((xx<<7)&0x80)|((xx<<5)&0x40)|((xx<<3)&0x20)|((xx<<1)&0x10)|((xx>>7)&0x01)|((xx>>5)&0x02)|((xx>>3)&0x04)|((xx>>1)&0x08);
	delay_ms(5);
	en=1;					  				  /*给E一个高脉冲将数据送入液晶控制器，完成写入操作*/
	delay_ms(5);
	en=0;					  				  /*完成写入操作，恢复“0”态，以便下次写入*/
}	
/*****************************
* 函数名：write_data
* 描述：1602液晶写数据函数
* 输入：无
* 输出：无
* 调用：外部调用
******************************/
void write_data(unsigned int Data)	   	 /*参考 输入指令函数*/
{
	unsigned char xx;
	rs=1;
	rw=0;
	xx=Data;					         /*并行传输数据*/
	P0=((xx<<7)&0x80)|((xx<<5)&0x40)|((xx<<3)&0x20)|((xx<<1)&0x10)|((xx>>7)&0x01)|((xx>>5)&0x02)|((xx>>3)&0x04)|((xx>>1)&0x08);
	en=0;
	delay_ms(5);
	en=1;
	delay_ms(5);
	en=0;
}
/**************************************************************************************
* 函数名：lcd_init
* 描述：1602液晶初始化函数
* 输入：无
* 输出：无
* 调用：外部调用
**************************************************************************************/
void lcd_init()
{
		write_command(0x38);					/*设置16x2显示，5x7点阵，8位数据接口*/
		write_command(0x0c);					/*设置开显示，不显示光标*/
		write_command(0x06);					/*写一个字符后地址指针加1*/
		write_command(0x01);					/*显示清0，数据指针清0*/


}		

/***********************************************************************
* 函数名：lcd_display
* 描述：1602液晶显示函数
* 输入：无
* 输出：无
* 调用：外部调用
***********************************************************************/
//void lcd_display()
//{ 
//		unsigned char num1;
// 		write_command(0x80+0x03);
//		for(num1=0;num1<10;num1++)
//			write_data(table0[num1]);	 		/*显示第一行固定内容 "0123456789"*/
//
//		write_command(0x80+0x40);
//		for(num1=0;num1<16;num1++)
//			write_data(table1[num1]);	 		/*显示第二行固定内容 "Made by HualiElC"*/	
//}


//void main()
//{
//	lcd_init();					 /*初始化1602液晶*/
//	lcd_display();			  	 /*液晶显示*/
//	while(1);
//}